## CMakeLists.txt
```
cmake_minimum_required(VERSION 3.8.2)
include($ENV{ZEPHYR_BASE}/cmake/app/boilerplate.cmake NO_POLICY_SCOPE)
project(td1)

FILE(GLOB app_sources src/*.c)
target_sources(app PRIVATE ${app_sources})
```

## prj.conf
```kconfig
CONFIG_NETWORKING=y
CONFIG_NET_BUF=y
CONFIG_NET_BUF_USER_DATA_SIZE=4
CONFIG_MQTT_LIB=y
CONFIG_HTTP=y
CONFIG_HTTP_SERVER=y
CONFIG_JSON_LIBRARY=y
CONFIG_NET_TCP=y
CONFIG_NET_IPV6=y
CONFIG_NET_CONFIG_AUTO_INIT=y
CONFIG_NET_CONFIG_NEED_IPV6=y
CONFIG_NET_CONFIG_NEED_IPV6_ROUTER=y

# debug/development options
#CONFIG_NET_SHELL=y
#CONFIG_DEBUG_OPTIMIZATIONS=y
CONFIG_MPU_STACK_GUARD=y
```

## src/main.c
```c
#include <net/socket.h>
#include "mqtt.h"
#include "http.h"
#include "pump.h"

void main(void)
{
	mqtt_start();
	http_start();
	pump_init();
}
```

## src/http.c
```c
#include <net/http.h>
#include <json.h>
#include "pump.h"

static u8_t request_buffer[512];

static struct http_ctx http_ctx;
static struct http_server_urls http_urls;

static void send_response(struct http_ctx *ctx,
			  const struct sockaddr *dst,
			  char *status,
			  bool json,
			  char *body,
			  int bodylen)
{
	char header[64];
	char *content_type = "application/json";
	if (!json)
		content_type = "text/html";

	snprintf(header, sizeof header, HTTP_PROTOCOL " %s" HTTP_CRLF, status);
	http_add_header(ctx, header, dst, NULL);
	http_add_header_field(ctx, "Content-Type", content_type, dst, NULL);
	http_add_header_field(ctx, "Transfer-Encoding", "chunked", dst, NULL);

	snprintf(header, sizeof header, "%d", bodylen);
	http_add_header_field(ctx, "Content-Length", header, dst, NULL);
	http_add_header(ctx, HTTP_CRLF, dst, NULL);

	http_send_chunk(ctx, body, bodylen, dst, NULL);
	http_send_chunk(ctx, NULL, 0, dst, NULL);
	//http_add_header(ctx, HTTP_CRLF, dst, NULL);
	http_send_flush(ctx, NULL);
	http_close(ctx);
}


static void respond_not_found(struct http_ctx *ctx,
			      const struct sockaddr *dst)
{
	char body[] = "<body><html>Error 404 not found</html></body>";
	send_response(ctx, dst, "404 Not Found", false, body, sizeof body);
}

static void respond_error(struct http_ctx *ctx,
			  const struct sockaddr *dst,
			  char *string)
{
	char body[64];
	int bodylen = snprintf(body, sizeof body,
			       "<body><html>%s</html></body>", string);
	send_response(ctx, dst, "500 Error", false, body, bodylen);
}

static void pump_request(struct http_ctx *ctx,
			 const struct sockaddr *dst,
			 enum http_method method)
{
	char* body = strstr(ctx->http.url, "\r\n\r\n");
	int ret;

	if (method == HTTP_PUT) {
		if (body) {
			if (pump_consume_json(body, strlen(body)) < 0) {
				respond_error(ctx, dst, "consume json failed");
				return;
			}
		}
		else
			printk("PUT without body!\n%s\n", ctx->http.url);
	}

	char outbuf[128];
	ret = pump_produce_json(outbuf, sizeof outbuf);
	if (ret < 0) {
		respond_error(ctx, dst, "produce json failed");
		return;
	}
	send_response(ctx, dst, "200 OK", true, outbuf, strlen(outbuf));
}

static enum http_verdict url_handler(struct http_ctx *ctx,
				     enum http_connection_type type,
				     const struct sockaddr *dst)
{
#if 1 // debug output
	char url[128];
	int url_len = ctx->http.url_len;

	if (url_len >= sizeof url)
		url_len = sizeof url - 1;
	memcpy(url, ctx->http.url, url_len);
	url[url_len] = 0;

	printk("http in : %s %s\n", http_method_str(ctx->http.parser.method), url);
#endif

	if (!strncmp(ctx->http.url, "/v1/pumps/0", ctx->http.url_len)) {
		pump_request(ctx, dst, ctx->http.parser.method);
	}
	else
		respond_not_found(ctx, dst);
	return HTTP_VERDICT_DROP;
}

void http_start(void)
{
	struct sockaddr *server_addr;
	server_addr = NULL;

	http_server_add_default(&http_urls, url_handler);

	int ret = http_server_init(&http_ctx, &http_urls,
				   server_addr,
				   request_buffer, sizeof request_buffer,
				   NULL,
				   NULL);
	if (ret < 0) {
		printk("Failed to initialize HTTP server (%d)\n", ret);
		return;
	}

	http_set_cb(&http_ctx, NULL, NULL, NULL, NULL );

	http_server_enable(&http_ctx);
	printk("HTTP server started\n");
}
```

## src/mqtt.c
```c
#include <zephyr.h>
#include <net/socket.h>
#include <net/mqtt.h>

#include "pump.h"

#define MQTT_PORT 1883 /* plain text */
#define MQTT_SERVER "2001:1002::1" /* todo: auto detect */
#define MQTT_CLIENTID "pump_module"
#define MQTT_BUFFER_SIZE 128
#define STACKSIZE 1024
#define CONNECT_TIMEOUT 5000 // ms
#define MQTT_PING_TIME  30000 // ms
#define INPUT_THREAD_DELAY 1000 // ms
#define OUTPUT_THREAD_DELAY 2000 // ms

#define TOPIC_NODE0_INFO "node0/info"
#define WILL_MESSAGE "{\"ip_addr\":\"\"}"

/* The mqtt client struct */
static struct mqtt_client mqtt_client;

static bool connected = false;

static char node_ip_address[NET_IPV6_ADDR_LEN];
static char node_version[16];

struct node {
	char *ip_addr;
	char *version;
} node_data = {
	.ip_addr = node_ip_address,
	.version = node_version
};

static const struct json_obj_descr node_descr[] = {
	JSON_OBJ_DESCR_PRIM(struct node, ip_addr, JSON_TOK_STRING),
	JSON_OBJ_DESCR_PRIM(struct node, version, JSON_TOK_STRING),
};

void mqtt_publish_topic(char *topic, char *payload, bool retain)
{
	struct mqtt_publish_param param;
        const enum mqtt_qos qos = MQTT_QOS_0_AT_MOST_ONCE;

	param.message.topic.qos = qos;
	param.message.topic.topic.utf8 = topic;
	param.message.topic.topic.size = strlen(topic);
	param.message.payload.data = payload;
	param.message.payload.len = strlen(payload);
	param.message_id = sys_rand32_get();
	param.dup_flag = 0;
	param.retain_flag = retain ? 1 : 0;

	int rc = mqtt_publish(&mqtt_client, &param);
        if (rc < 0)
                printk("mqtt_publish %d\n", rc);
	printk("mqtt out: %s: %s\n", topic, payload);
}

static void announce_node(void)
{
        char jsonbuf[80];

	strcpy(node_data.version, "0.1");

	int ret = json_obj_encode_buf(node_descr, ARRAY_SIZE(node_descr),
				      &node_data, jsonbuf, sizeof jsonbuf);
	if (ret < 0) {
		printk("mqtt: produce json failed\n");
		return;
	}
	mqtt_publish_topic(TOPIC_NODE0_INFO, jsonbuf, true);
}

static void event_handler(struct mqtt_client *const client,
                          const struct mqtt_evt *event)
{
	switch (event->type) {
                case MQTT_EVT_CONNACK:
                        printk("MQTT connected\n");
                        connected = true;
			announce_node();
                        break;

                case MQTT_EVT_DISCONNECT:
                        printk("MQTT disconnected\n");
                        connected = false;
                        break;

                default:
                        break;
        }
}

static void wait_for_ip_address(void)
{
	struct net_if *iface = net_if_get_default();

	while (true) {
		for (int i=0; i<NET_IF_MAX_IPV6_ADDR; i++) {
			struct in6_addr *addr = &iface->config.ip.ipv6->
				unicast[i].address.in6_addr;
			if (!net_ipv6_is_ll_addr(addr) &&
			    !net_ipv6_is_addr_unspecified(addr)) {
				net_addr_ntop(AF_INET6, addr,
					      node_data.ip_addr,
					      sizeof node_data.ip_addr);
				printk("Node IP address: %s\n",
				       node_data.ip_addr);
				return;
			}
		}
		printk("No IP address\n");
		k_sleep(2000);
	}
}
static void configure_client(struct mqtt_client *client)
{
        static u8_t rx_buffer[MQTT_BUFFER_SIZE];
        static u8_t tx_buffer[MQTT_BUFFER_SIZE];
        static struct sockaddr_storage mqtt_broker;
	static struct mqtt_topic will_topic = {
		.topic = {
			.utf8 = TOPIC_NODE0_INFO,
			.size = sizeof TOPIC_NODE0_INFO
		},
		.qos = MQTT_QOS_1_AT_LEAST_ONCE
	};
	static struct mqtt_utf8 will_message = {
		.utf8 = WILL_MESSAGE,
		.size = sizeof WILL_MESSAGE
	};

	wait_for_ip_address();

        /* set broker address */
	struct sockaddr_in6 *broker6 = (struct sockaddr_in6 *)&mqtt_broker;
	broker6->sin6_family = AF_INET6;
	broker6->sin6_port = htons(MQTT_PORT);
	inet_pton(AF_INET6, MQTT_SERVER, &broker6->sin6_addr);

        /* reset mqtt client struct */
	mqtt_client_init(client);

	/* MQTT client configuration */
	client->broker = &mqtt_broker;
	client->evt_cb = event_handler;
	client->client_id.utf8 = (u8_t *)MQTT_CLIENTID;
	client->client_id.size = strlen(MQTT_CLIENTID);
	client->password = NULL;
	client->user_name = NULL;
	client->protocol_version = MQTT_VERSION_3_1_1;
	client->will_topic = &will_topic;
	client->will_message = &will_message;
	client->will_retain = false;

	/* MQTT buffers configuration */
	client->rx_buf = rx_buffer;
	client->rx_buf_size = sizeof(rx_buffer);
	client->tx_buf = tx_buffer;
	client->tx_buf_size = sizeof(tx_buffer);

	/* MQTT transport configuration */
#if defined(CONFIG_MQTT_LIB_TLS)
	client->transport.type = MQTT_TRANSPORT_SECURE;

	struct mqtt_sec_config *tls_config = &client->transport.tls.config;

	tls_config->peer_verify = 2;
	tls_config->cipher_list = NULL;
	tls_config->seg_tag_list = m_sec_tags;
	tls_config->sec_tag_count = ARRAY_SIZE(m_sec_tags);
# if defined(MBEDTLS_X509_CRT_PARSE_C)
	tls_config->hostname = TLS_SNI_HOSTNAME;
# else
	tls_config->hostname = NULL;
# endif
#else
	client->transport.type = MQTT_TRANSPORT_NON_SECURE;
#endif
}

static struct pollfd poll_socket;
static void prepare_fds(struct mqtt_client *client)
{
	if (client->transport.type == MQTT_TRANSPORT_NON_SECURE)
		poll_socket.fd = client->transport.tcp.sock;
#if defined(CONFIG_MQTT_LIB_TLS)
	else if (client->transport.type == MQTT_TRANSPORT_SECURE) {
		poll_socket.fd = client->transport.tls.sock;
#endif

	poll_socket.events = ZSOCK_POLLIN;
}

static void reconnect(void)
{
        while (!connected) {
                int rc;
                printk("mqtt_connect()\n");
                rc = mqtt_connect(&mqtt_client);
                if (rc < 0) {
			printk("mqtt_connect %d\n", rc);
                        k_sleep(1000);
                        continue;
                }

                /* wait for response */
                prepare_fds(&mqtt_client);
                poll(&poll_socket, 1, CONNECT_TIMEOUT);

                printk("mqtt_input()\n");
                rc = mqtt_input(&mqtt_client);
                if (rc < 0)
                        printk("mqtt_input %d\n", rc);

                if (connected)
                        break;

                printk("mqtt is not connected\n");
                mqtt_abort(&mqtt_client);
                k_sleep(1000); // back off a second
        }
}

static void input_loop(void)
{
        configure_client(&mqtt_client);

        while (1) {
                int rc;

                if (!connected)
                        reconnect();

                if (poll(&poll_socket, 1, CONNECT_TIMEOUT)) {
                        rc = mqtt_input(&mqtt_client);
                        if (rc != 0) {
                                printk("mqtt_input %d\n", rc);
                                continue;
                        }
                }

                /* ping */
                rc = mqtt_live(&mqtt_client);
                if (rc < 0)
                        printk("mqtt_live failed %d\n", rc);

        }
}

static struct pump last_pump_data;

static void output_loop(void)
{
        struct pump *pump_data = pump_data_get();
	memset(&last_pump_data, 0xff, sizeof last_pump_data);

        while (1) {
                /* todo: make generic */
                if (last_pump_data.activated != pump_data->activated) {
                        char buf[8];
                        snprintf(buf, sizeof buf, "%d", pump_data->activated);
                        mqtt_publish_topic("node0/pump/activated", buf, true);
                }

                if (last_pump_data.set_speed != pump_data->set_speed) {
                        char buf[8];
                        snprintf(buf, sizeof buf, "%d", pump_data->set_speed);
                        mqtt_publish_topic("node0/pump/set_speed", buf, true);
                }
                last_pump_data = *pump_data;
                pump_data_wait();
        }
}

/* thread */
__kernel struct k_thread input_thread;
K_THREAD_STACK_DEFINE(input_stack, STACKSIZE);

__kernel struct k_thread output_thread;
K_THREAD_STACK_DEFINE(output_stack, STACKSIZE);

void mqtt_start(void)
{
        k_thread_create(&input_thread, input_stack, sizeof input_stack,
                        (k_thread_entry_t)input_loop,
                        NULL, NULL, NULL, -1, K_USER, INPUT_THREAD_DELAY);

	k_thread_create(&output_thread, output_stack, sizeof output_stack,
                        (k_thread_entry_t)output_loop,
                        NULL, NULL, NULL, -1, K_USER, OUTPUT_THREAD_DELAY);
}
```

## src/mqtt.h
```c
#pragma once

void mqtt_start(void);
void mqtt_publish_topic(char *topic, char *payload);
```

## src/pump.c
```c
#include <zephyr.h>
#include <device.h>
#include <gpio.h>
#include "pump.h"

struct pump pump_data;
static struct device *gpioe;

static const struct json_obj_descr pump_descr[] = {
	JSON_OBJ_DESCR_PRIM(struct pump, activated, JSON_TOK_TRUE),
	JSON_OBJ_DESCR_PRIM(struct pump, set_speed, JSON_TOK_NUMBER),
};

K_SEM_DEFINE(data_sem, 1, 1);	/* starts off "available" */

void pump_data_updated(void)
{
	k_sem_give(&data_sem);
}

void pump_data_wait(void)
{
	k_sem_take(&data_sem, K_FOREVER);
}

struct pump *pump_data_get(void)
{
	return &pump_data;
}

void pump_action(void)
{
	gpio_pin_write(gpioe, 9, pump_data.activated);
}

int pump_consume_json(char *json, int len)
{
	int ret;

	ret = json_obj_parse(json, len, pump_descr, ARRAY_SIZE(pump_descr),
			     &pump_data);
	if (ret < 0)
		return ret;

	pump_data_updated();
	pump_action();
	return 0;
}

int pump_produce_json(char *outbuf, int len)
{
	int ret = json_obj_encode_buf(pump_descr, ARRAY_SIZE(pump_descr),
				      &pump_data, outbuf, len);
	return ret;
}

int pump_init(void)
{
	gpioe = device_get_binding("GPIOE");
	if (!gpioe) {
          printk("error line %d\n", __LINE__);
          return -EINVAL;
	}

	gpio_pin_configure(gpioe, 9, GPIO_DIR_OUT);
	gpio_pin_configure(gpioe, 11, GPIO_DIR_OUT);
	gpio_pin_write(gpioe, 11, true);
	return 0;
}
```

## src/pump.h
```c
#pragma once

#include <json.h>

struct pump {
	bool activated;
	int set_speed;
};

void pump_data_updated(void);
void pump_data_wait(void);
int pump_consume_json(char *json, int len);
int pump_produce_json(char *outbuf, int len);
struct pump *pump_data_get(void);
struct json_obj_descr *pump_json_get(void);
int pump_init(void);
```
